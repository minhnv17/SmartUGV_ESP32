## main/Kconfig.projbuild
```kconfig
# put here your custom config value
menu "Example Configuration"
config ESP_WIFI_SSID
    string "WiFi SSID"
    default "myssid"
    help
	SSID (network name) for the example to connect to.

config ESP_WIFI_PASSWORD
    string "WiFi Password"
    default "mypassword"
    help
	WiFi password (WPA or WPA2) for the example to use.
endmenu

menu "Robot Display"
config ROBOT_FACE_FLIP_LANDSCAPE
    bool "Flip landscape display 180 degrees"
    default n
    help
        Enable if the face is upside down after mounting the display horizontally.
        Both orientations use a 320x240 layout.
endmenu
```

## sdkconfig.defaults
```kconfig
# LCDWIKI ES3C28P / ESP32-S3 N16R8
CONFIG_IDF_TARGET="esp32s3"
CONFIG_ESPTOOLPY_FLASHSIZE_16MB=y
CONFIG_PARTITION_TABLE_SINGLE_APP_LARGE=y
CONFIG_SPIRAM=y
CONFIG_SPIRAM_MODE_OCT=y
CONFIG_SPIRAM_SPEED_40M=y
CONFIG_SPIRAM_USE_MALLOC=y
CONFIG_MBEDTLS_CERTIFICATE_BUNDLE=y
CONFIG_MBEDTLS_CERTIFICATE_BUNDLE_CROSS_SIGNED_VERIFY=y

CONFIG_ESP_WS_CLIENT_SEPARATE_TX_LOCK=y
```
